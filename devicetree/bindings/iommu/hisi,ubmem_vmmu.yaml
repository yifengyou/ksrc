## devicetree/bindings/iommu/hisi,ubmem_vmmu.yaml
```yaml
# SPDX-License-Identifier: (GPL-2.0-only OR BSD-2-Clause)
%YAML 1.2
---
$id: http://devicetree.org/schemas/iommu/hisi,ubmem_vmmu.yaml#
$schema: http://devicetree.org/meta-schemas/core.yaml#

title: HiSilicon ubmem_vmmu Architecture Implementation

maintainers:
  - Lizhi He <helizhi1@huawei.com>

description: |+
  ubmem_vmmu is an IOMMU device used in a VM, it achieves the mapping/unmapping of UBA -> GPA through iommu_map/iommu_unmap.

properties:
  $nodename:
    pattern: "^ubmem_vmmu$"

  compatible:
    const: hisi,ubmem_vmmu

required:
  - compatible

additionalProperties: false

examples:
  - |+
    ubmem_vmmu {
        compatible = "hisi,ubmem_vmmu";
    };
```

## devicetree/bindings/iommu/hisi,ummu.yaml
```yaml
# SPDX-License-Identifier: (GPL-2.0-only OR BSD-2-Clause)
%YAML 1.2
---
$id: http://devicetree.org/schemas/iommu/hisi,ummu.yaml#
$schema: http://devicetree.org/meta-schemas/core.yaml#

title: HiSilicon UMMU Architecture Implementation

maintainers:
  - Jingbin Wu <wujingbin2@huawei.com>

description: |+
  UMMU is an IOMMU device that performs address translation and permission checking
  using DstEID, TokenID, and UBA as input parameters.

properties:
  $nodename:
    pattern: "^ummu@[0-9a-f]*"
  compatible:
    const: ub,ummu
  index:
    $ref: /schemas/types.yaml#/definitions/uint32
    description: |
      UMMU device index. Used to identify a specific UMMU instance in systems
      with multiple UMMU devices.
  msi-parent:
    $ref: /schemas/types.yaml#/definitions/phandle
    description: |
      MSI parent device phandle. Required for MSI interrupt handling.

required:
  - compatible
  - index
  - msi-parent

additionalProperties: false

examples:
  - |+
    ummu@0 {
        compatible = "ub,ummu";
        index = <0x0>;
        msi-parent = <&its>;
    };
```

## devicetree/bindings/perf/hisi,ummu-pmu.yaml
```yaml
# SPDX-License-Identifier: (GPL-2.0-only OR BSD-2-Clause)
%YAML 1.2
---
$id: http://devicetree.org/schemas/perf/hisi,ummu-pmu.yaml#
$schema: http://devicetree.org/meta-schemas/core.yaml#

title: HiSilicon UMMU Performance Monitor Unit (PMU)

maintainers:
  - Jingbin Wu <wujingbin2@huawei.com>

description: |
  The UMMU includes a PMU(Performance Monitor Unit ) to monitor and collect
  statistics on key hardware events, such as TLB/PLB cache hit rates and
  lookup latencies.

properties:
  $nodename:
    pattern: "^ummu-pmu@[0-9a-f]*"
  compatible:
    const: ub,ummu_pmu
  index:
    $ref: /schemas/types.yaml#/definitions/uint32
    description: |
      PMU device index. Identifies a specific UMMU-PMU instance in multi-UMMU-PMU
      systems.
  msi-parent:
    $ref: /schemas/types.yaml#/definitions/phandle
    description: |
      MSI parent device phandle. Required for MSI interrupt handling.

required:
  - compatible
  - index
  - msi-parent

additionalProperties: false

examples:
  - |
    ummu-pmu@0 {
        compatible = "ub,ummu_pmu";
        index = <0x0>;
        msi-parent = <&its>;
    };
```

## devicetree/bindings/ub/hisi,ubc.yaml
```yaml
# SPDX-License-Identifier: (GPL-2.0-only OR BSD-2-Clause)
%YAML 1.2
---
$id: http://devicetree.org/schemas/ub/hisi,ubc.yaml#
$schema: http://devicetree.org/meta-schemas/core.yaml#

title: HiSilicon UBC (Unified Bus Controller) platform device

maintainers:
  - Yuhao Xiang <xiangyuhao2@huawei.com>

description: |+
  This platform device was added to enable the automatic loading of the
  hisi_ubus driver. If this feature is not needed, you can omit adding this
  device and manually load the driver instead.

properties:
  $nodename:
    pattern: "^hisi-ubc$"
    description: |
      The node name should be "hisi-ubc".

  compatible:
    const: "hisi,ubc"
    description: |
      The compatible property should be "hisi,ubc" to identify the device as a
      HiSilicon UBC platform device.

unevaluatedProperties: false

examples:
  - |+
    hisi-ubc {
        compatible = "hisi,ubc";
    };
```

## devicetree/bindings/ub/ub,ubc.yaml
```yaml
# SPDX-License-Identifier: (GPL-2.0-only OR BSD-2-Clause)
%YAML 1.2
---
$id: http://devicetree.org/schemas/ub/ub,ubc.yaml#
$schema: http://devicetree.org/meta-schemas/core.yaml#

title: UBC (Unified Bus Controller) platform device

maintainers:
  - Yuhao Xiang <xiangyuhao2@huawei.com>

description: |
  The UBC platform device reported UBC interrupt number and the association
  between the ubc and the interrupt controller.

properties:
  $nodename:
    pattern: "^ubc@[0-9a-f]*"

  compatible:
    const: "ub,ubc"

  interrupts:
    maxItems: 1
    description: |
      The interrupt specifier for the UBC. Used by the msgq of the ub controller.

  index:
    $ref: /schemas/types.yaml#/definitions/uint32
    description: |
      The index of the UBC. This is used to identify the specific UBC
      in a system with multiple UBC devices. Starts from 0.

  msi-parent:
    description: The msi interrupt for the UBC. Used by the ub entity connected
      to UBC.

required:
  - compatible
  - interrupts
  - index
  - msi-parent

unevaluatedProperties: true

examples:
  - |+
    ubc@0 {
        compatible = "ub,ubc";
        #interrupt-cells = <0x3>;
        interrupt-parent = <0x01>;
        interrupts = <0x00 0xcb 0x4>;
        index = <0x00>;
        msi-parent = <&its 0x54c0>;
    };
```
